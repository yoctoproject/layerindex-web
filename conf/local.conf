## conf/local.conf
```bitbake
#
# This is a version of local.conf trimmed specially for parsing recipes
# within the OE Layer index update script. Since we're not doing any
# actual building and many variables are defaulted via bitbake.conf or
# the OE-Core basic distro config, we don't need to set very much.

# Just select something basic here:
MACHINE = "qemux86"

# OE-Core basic distro configuration
DISTRO = ""

# We're not doing any building, no need to error on missing host tools,
# but move them to HOSTTOOLS_NONFATAL just in case any do get called
# from anonymous python or python expressions
HOSTTOOLS_NONFATAL := "${@d.getVar('HOSTTOOLS', True) or ''} ${@d.getVar('HOSTTOOLS_NONFATAL', True) or ''}"
# We do definitely need gcc since populate_sdk_base.bbclass refers to
# oe.utils.get_gcc_version() in a python expression
HOSTTOOLS = "gcc"
```

## oe-classic/conf/local.conf
```bitbake
#
# This is a version of local.conf trimmed specially for parsing recipes
# within the OE Layer index update script. Since we're not doing any
# actual building and many variables are defaulted via bitbake.conf or
# the "minimal" distro config, we don't need to set very much.

# Just select something basic here:
MACHINE = "qemux86"

# OE-Classic basic distro configuration
DISTRO = "minimal"

# Ensure we select a packaging backend so image recipes parse
INHERIT += "package_ipk"
```
